## components/FastLED-idf/Kconfig
```kconfig
menu "FastLED"

    choice FASTLED_ESP32_DRIVER_MODE
        prompt "Driver Mode"
        default FASTLED_ESP32_DRIVER_I2S
        help
            FastLED can use the RMT peripheral or I2S peripheral to drive the LEDs.
            I2S has more accurate timing, lower overheads, and is the recommended choice.
            Select RMT if you need the I2S peripheral for other purposes, or you just to use RMT.

        config FASTLED_ESP32_DRIVER_I2S
            bool "I2S peripheral"
        config FASTLED_ESP32_DRIVER_RMT
            bool "RMT peripheral"
    endchoice

    config FASTLED_ESP32_DRIVER
        string
        default "i2s" if FASTLED_ESP32_DRIVER_I2S
        default "rmt" if FASTLED_ESP32_DRIVER_RMT

    config FASTLED_ALL_PINS_HARDWARE_SPI
        bool "Use hardware SPI for all pins"
        default false
        help

    choice FASTLED_ESP32_SPI_BUS_SEL
        prompt "Hardware SPI bus"
        default FASTLED_ESP32_SPI_BUS_VSPI
        depends_on
        help
            This driver uses the VSPI bus by default (GPIO 18, 19, 23, & 5).
            If you need VSPI for other things, select the HSPI bus (GPIO 14, 12, 13, & 15) here.
            Pin definitions may be different for ESP32-S2/S3/C3/etc.

        config FASTLED_ESP32_SPI_BUS_VSPI
            bool "VSPI bus"
        config FASTLED_ESP32_SPI_BUS_HSPI
            bool "HSPI bus"
    endchoice

    config FASTLED_ESP32_SPI_BUS
        string
        default "VSPI" if FASTLED_ESP32_SPI_BUS_VSPI
        default "HSPI" if FASTLED_ESP32_SPI_BUS_HSPI

    config FASTLED_USE_

endmenu
```

## components/FastLED-idf/Kconfig.projbuild
```kconfig
menu "FastLED"

    config FASTLED_ESP32_I2S
        bool "Use I2S instead of RMT"
        default y
        help
            Removes the RMT sources and uses RMT instead of I2S.

endmenu
```

## sdkconfig.defaults.esp32
```kconfig
CONFIG_COMPILER_OPTIMIZATION_PERF=y
CONFIG_LWIP_LOCAL_HOSTNAME="fastled"

CONFIG_ESP32_REV_MIN_1=y
CONFIG_ESP32_DEFAULT_CPU_FREQ_240=y
CONFIG_ESP32_RTC_CLK_SRC_INT_8MD256=y
CONFIG_ESP32_XTAL_FREQ_AUTO=y
CONFIG_ESP32_XTAL_FREQ=0

CONFIG_ESP32_RTC_CLOCK_SOURCE_INTERNAL_8MD256=y
```
